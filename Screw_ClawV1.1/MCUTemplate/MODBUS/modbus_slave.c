#include "modbus_slave.h"
#include "config.h"
#include "timer.h"
#include "bll_main.h"
#include "usart.h"
#include "string.h"
#include "delay.h"

//modbus数组高位
static const unsigned char aucCRCHi[] = {
    0x00, 0xC1, 0x81, 0x40, 0x01, 0xC0, 0x80, 0x41, 0x01, 0xC0, 0x80, 0x41,
    0x00, 0xC1, 0x81, 0x40, 0x01, 0xC0, 0x80, 0x41, 0x00, 0xC1, 0x81, 0x40,
    0x00, 0xC1, 0x81, 0x40, 0x01, 0xC0, 0x80, 0x41, 0x01, 0xC0, 0x80, 0x41,
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    0x00, 0xC1, 0x81, 0x40
};
//modbus数组低位
static const unsigned char aucCRCLo[] = {
    0x00, 0xC0, 0xC1, 0x01, 0xC3, 0x03, 0x02, 0xC2, 0xC6, 0x06, 0x07, 0xC7,
    0x05, 0xC5, 0xC4, 0x04, 0xCC, 0x0C, 0x0D, 0xCD, 0x0F, 0xCF, 0xCE, 0x0E,
    0x0A, 0xCA, 0xCB, 0x0B, 0xC9, 0x09, 0x08, 0xC8, 0xD8, 0x18, 0x19, 0xD9,
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    0x41, 0x81, 0x80, 0x40
};

static volatile ModBusState MState = MODBUS_IDLE;
//vu16 Reg_4x[MODBUS_REG_COUNT];


static volatile u16 RecCount=0;
static u8 RecBuff[MODBUS_BUFF_LEN];

void ModBus_SetTimeout(void)
{
	MState = MODBUS_TIMEOUT;
}

void Modbus_ResetToIdle(void)
{
	MState = MODBUS_IDLE;
}

//计算CRC16
static uint16_t Get_CRC16( unsigned char * pucFrame, uint16_t usLen )
{
    unsigned char  ucCRCHi = 0xFF;
    unsigned char  ucCRCLo = 0xFF;
    u16 iIndex=0;

    while( usLen-- )
    {
        iIndex = ucCRCLo ^ *( pucFrame++ );
        ucCRCLo = ( unsigned char )( ucCRCHi ^ aucCRCHi[iIndex] );
        ucCRCHi = aucCRCLo[iIndex];
    }
	Data8To16(usLen,ucCRCHi,ucCRCLo);
    return usLen;
}

static void Attach_CRC16(unsigned char* pucFrame, uint16_t dataLen)
{
	 unsigned char  ucCRCHi = 0xFF;
    unsigned char  ucCRCLo = 0xFF;
	uint16_t usLen = dataLen;
    u16 iIndex=0;
	unsigned char* p=pucFrame;

    while( usLen-- )
    {
        iIndex = ucCRCLo ^ *( pucFrame++ );
        ucCRCLo = ( unsigned char )( ucCRCHi ^ aucCRCHi[iIndex] );
        ucCRCHi = aucCRCLo[iIndex];
    }
#if CRC_ORDER
	p[dataLen+1] = ucCRCHi;
	p[dataLen] = ucCRCLo;
#else
	p[dataLen] = ucCRCHi;
	p[dataLen+1] = ucCRCLo;
#endif
	
}

static unsigned char Check_CRC16(unsigned char* p,u16 count)
{
	u16 crc = 0;
#if CRC_ORDER
	Data8To16(crc,p[count-1], p[count-2]);
#else
	Data8To16(crc,p[count-2], p[count-1]);
#endif
	if(crc == Get_CRC16(p,count - 2))
		return 1;
	return 0;
}

void ModBusRecByte(u8 data)
{
	if(MState == MODBUS_IDLE)
	{
		RecBuff[0] = data;
		RecCount = 1;
		FUN_RESET_TIMER();
		FUN_START_TIMER();
		MState = MODBUS_RECING;
	}
	else if(MState == MODBUS_RECING)
	{
		RecBuff[RecCount++] = data;
		if (RecCount >= MODBUS_BUFF_LEN)
			RecCount = 0;
		FUN_RESET_TIMER();
	}
}

static void Handle_0x03(void);
static void Handle_0x06(void);
static void Handle_0x10(void);
static void Handle_0x64(void);
static void SendError(u8 fun, ModBusFailCode_Type errcode);

extern void BLL_Update(void);
void ModBus_Pool(void)
{
	ModBusFailCode_Type errcode = MODBUS_OK;
	if(MState == MODBUS_TIMEOUT)
	{
		MState = MODBUS_HANDLING;	
		if (RecBuff[0] != MODBUS_ADDR)
		{
			MState = MODBUS_IDLE;
			return;
		}
#if SKIP_CRC==0
		if (!Check_CRC16(RecBuff, RecCount))
		{
			//errcode = MODBUS_ERR_CRC;
			//goto errorsend;
			MState = MODBUS_IDLE;
			return;
		}
#endif
		FUN_485_DIR(DIR_485_WRITEONLY);
		switch(RecBuff[1])
		{
			case 0x03:Handle_0x03();break;
			case 0x06:Handle_0x06();break;
			case 0x10:Handle_0x10();break;
			case 0x64:Handle_0x64();break;
		}
		goto end0;
errorsend:
		SendError(RecBuff[1], errcode);	
end0:	
		MState = MODBUS_SENDING;
		FUN_485_DIR(DIR_485_READONLY);
	}
}

__weak u8 ExecuteCommand_Handler(u16* cmd)
{
	return 0;
}

__weak void UpdateRawValue_Handler(u8 subaddr, u8 len)
{

}

static void Handle_0x03(void)
{
	u16 base_addr,len;
	Data8To16(base_addr,RecBuff[2],RecBuff[3]);
	Data8To16(len,RecBuff[4],RecBuff[5]);
	RecBuff[2] = 2*len;
	u8 region = base_addr / 100;
	u8 subaddr = base_addr % 100;
	if(!ValidateRegRange(region, subaddr + len))
	{
		SendError(0x03, MODBUS_ERR_Reg);
		return;
	}	
	if (region == 3)
		UpdateRawValue_Handler(subaddr, len);
	u16* p_reg = (u16*)Reg_Regions[region] + subaddr;
	u8* p_buff=&RecBuff[3];
	memcpy(p_buff, p_reg, 2*len);
	Attach_CRC16(RecBuff,3+RecBuff[2]);
	FUN_SEND_DATA(RecBuff,5+RecBuff[2]);
}

static void Handle_0x06(void)
{
	u16 base_addr,value;
	Data8To16(base_addr,RecBuff[2],RecBuff[3]);
	Data8To16(value,RecBuff[4],RecBuff[5]);
	u8 region = base_addr / 100;
	u8 subaddr = base_addr % 100;
	if (!ValidateRegRange(region, subaddr))
	{
		SendError(0x06, MODBUS_ERR_Reg);
		return;
	}
	u16* p_reg = (u16*)Reg_Regions[region] + subaddr;
	if (region == 5)
	{
		u8 rt = ExecuteCommand_Handler((u16*)Reg_Regions[5]);
		if (rt)
		{
			SendError(0x06, (ModBusFailCode_Type)rt);
			return;
		}
	}
	*p_reg = value;
	FUN_SEND_DATA(RecBuff,8);
}

static void Handle_0x10(void)
{
	u16 base_addr,len,len_byte;
	Data8To16(base_addr,RecBuff[2],RecBuff[3]);
	Data8To16(len,RecBuff[4],RecBuff[5]);
	len_byte = RecBuff[6];
	u8 region = base_addr / 100;
	u8 subaddr = base_addr % 100;
	if (!ValidateRegRange(region, subaddr + len))
	{
		SendError(0x10, MODBUS_ERR_Reg);
		return;
	}
	u16* p_reg = (u16*)Reg_Regions[region] + subaddr;
	u8* p_buff = &RecBuff[7];
	memcpy(p_reg, p_buff, len_byte);	
	if (region == 5)
	{
		u8 rt = ExecuteCommand_Handler((u16*)Reg_Regions[5]);
		if (rt)
		{
			SendError(0x10, (ModBusFailCode_Type)rt);
			return;
		}
	}
	Attach_CRC16(RecBuff,6);
	FUN_SEND_DATA(RecBuff,8);
}

extern u8 IsJumpIAP;
static void Handle_0x64(void)
{
	FUN_SEND_DATA(RecBuff,4);
	delay_ms(200);
	//BLL_Update();
	IsJumpIAP = 1;
}

static void SendError(u8 fun, ModBusFailCode_Type errcode)
{
	u8 err[5] = {MODBUS_ADDR, fun | 0x80, errcode};
	Attach_CRC16(err, 3);
	FUN_SEND_DATA(err, 5);
}
